//////////////////////////////////////////////////////////////////////////////////////////////////////////////////////////////////////////////////////////////////
//Defining Pinouts////////////////////////////////////////////////////////////////////////////////////////////////////////////////////////////////////////////////
//////////////////////////////////////////////////////////////////////////////////////////////////////////////////////////////////////////////////////////////////

#define PIN_SENSOR A1         //Rename Pin A1 to PIN_SENSOR

//////////////////////////////////////////////////////////////////////////////////////////////////////////////////////////////////////////////////////////////////
//Defining Array Variables////////////////////////////////////////////////////////////////////////////////////////////////////////////////////////////////////////
//////////////////////////////////////////////////////////////////////////////////////////////////////////////////////////////////////////////////////////////////

const int Elements=20;
int Readings[Elements];
   
//////////////////////////////////////////////////////////////////////////////////////////////////////////////////////////////////////////////////////////////////
//Define Distance Class///////////////////////////////////////////////////////////////////////////////////////////////////////////////////////////////////////////
//Defining Private Varibles///////////////////////////////////////////////////////////////////////////////////////////////////////////////////////////////////////
//////////////////////////////////////////////////////////////////////////////////////////////////////////////////////////////////////////////////////////////////

class DistanceSensor {
  private:                                                                        
    unsigned long NextTimeChange = 0;
    unsigned long OnTime;
    unsigned long CurrentTime;
    byte Pin;                                 
    float Voltage;
    float Distance;
    float DistancePoly;
    int SensorAverage = 0;
    double Total = 0;   
    int Index = 0;               
    bool CalcDist;
    bool Startup; 
    
//////////////////////////////////////////////////////////////////////////////////////////////////////////////////////////////////////////////////////////////////
//Pass data into private varibles/////////////////////////////////////////////////////////////////////////////////////////////////////////////////////////////////         
//////////////////////////////////////////////////////////////////////////////////////////////////////////////////////////////////////////////////////////////////    

  public:                                                                      
     DistanceSensor(byte Pin, unsigned long OnTime) {
        this->Pin = Pin;                                              //Pass value for Pin to Private Class
        this->OnTime = OnTime;                                        //Pass value for OnTime to Private Class
        
        pinMode(Pin, INPUT);                                          //Declare Pin as an Input
    }
//////////////////////////////////////////////////////////////////////////////////////////////////////////////////////////////////////////////////////////////////
//Smooth Analog Read Values///////////////////////////////////////////////////////////////////////////////////////////////////////////////////////////////////////             
//////////////////////////////////////////////////////////////////////////////////////////////////////////////////////////////////////////////////////////////////

    void SmoothInput() { 
        Total = Total - Readings[Index];                //Subtract Reading in Index position from Total before adding new reading
        Readings[Index] = getSensorValue();             //Get Value From Sensor
        Total = Total + Readings[Index];                //Add new reading to total
        Index = Index + 1;                              //Iterate to next position
        if (Startup) {                                  //If Bool Startup is true divide total by the index number to get average
          SensorAverage = Total/Index;
          if (Index==Elements){                         //When all elements have been populated change bool startup to false
            Startup=false;                              //This will allow for smoother initial startup
          }
        }
        else{
          SensorAverage = Total/Elements;               //Average the sum of the array                                 
        }
        if (Index >= Elements) {                        //If at last index position loop back to begaining
          Index = 0;
        }
    }

//////////////////////////////////////////////////////////////////////////////////////////////////////////////////////////////////////////////////////////////////   
//Initialize Values In Array//////////////////////////////////////////////////////////////////////////////////////////////////////////////////////////////////////
//////////////////////////////////////////////////////////////////////////////////////////////////////////////////////////////////////////////////////////////////

    void Initialize(){
      for (int thisReading = 0; thisReading < Elements; thisReading++) {        //Iterates through Array setting values to 0
        Readings[thisReading] = 0;
      } 
      Startup = true;
    }
    
//////////////////////////////////////////////////////////////////////////////////////////////////////////////////////////////////////////////////////////////////   
//Calculates Distance/////////////////////////////////////////////////////////////////////////////////////////////////////////////////////////////////////////////
//////////////////////////////////////////////////////////////////////////////////////////////////////////////////////////////////////////////////////////////////

    void CalcDistance() {
      CheckTime();
      if(CalcDist){                                                                                           
        Voltage = SensorAverage * (5.0 / 1023.0);                                                                           //Calculate Voltage
        Distance = -21.75*(Voltage) + 58.021;                                                                               //Calculate y=mx+c
        DistancePoly = 12.275*pow(Voltage,4) - 92.759*pow(Voltage,3) + 252.03*pow(Voltage,2) - 303.81*(Voltage) + 156.35;   //Calculate Polynomial 
        Print(); 
      }                                                                                      
    }
    
//////////////////////////////////////////////////////////////////////////////////////////////////////////////////////////////////////////////////////////////////
//Time Control for Smoothing and Sending Data/////////////////////////////////////////////////////////////////////////////////////////////////////////////////////
//////////////////////////////////////////////////////////////////////////////////////////////////////////////////////////////////////////////////////////////////

    void CheckTime(){           
      CurrentTime = millis();                               //Checks time and stores as CurrentTime                           
      if(CurrentTime >= NextTimeChange){                    //If CurrentTime is less than NextTimeChange
        CalcDist = true;                                    //Set CalDistbool = True
        NextTimeChange = NextTimeChange + OnTime;           //Increase NextTimeChange by OnTime 
      }
      else{
        CalcDist = false;                                   //Else set CalDistbool = False      
      }  
    }
    
//////////////////////////////////////////////////////////////////////////////////////////////////////////////////////////////////////////////////////////////////
//Prints Distance Data////////////////////////////////////////////////////////////////////////////////////////////////////////////////////////////////////////////
//////////////////////////////////////////////////////////////////////////////////////////////////////////////////////////////////////////////////////////////////

    void Print() {                                                           
       Serial.print("Distance (y=mx+c): ");                      //Print to Terminal "Distance (y=mx+c): "        
       Serial.print(Distance);                                   //Print to Terminal Distance Value
       Serial.print("     ");                                    //Print to Terminal "Space"
       Serial.print("Distance Polynomial: ");                    //Print to Terminal "Distance Polynomial: "
       Serial.print(DistancePoly);                               //Print to Terminal DistancePoly Value
       Serial.println(" ");                                      //Print to Terminal " " and start new line                                                
    }
    
//////////////////////////////////////////////////////////////////////////////////////////////////////////////////////////////////////////////////////////////////
//Get Sensor Value////////////////////////////////////////////////////////////////////////////////////////////////////////////////////////////////////////////////
//////////////////////////////////////////////////////////////////////////////////////////////////////////////////////////////////////////////////////////////////

    int getSensorValue(){                          //Stores value from sensor as getSensorValue                                                                                                    
      return analogRead(PIN_SENSOR);
    }
    
//////////////////////////////////////////////////////////////////////////////////////////////////////////////////////////////////////////////////////////////////
//Get Poly Distance///////////////////////////////////////////////////////////////////////////////////////////////////////////////////////////////////////////////
//////////////////////////////////////////////////////////////////////////////////////////////////////////////////////////////////////////////////////////////////     

    float getPolyDistance(){                      //Stores DistancePoly as getPolyDistance for use in Servo Class
      return DistancePoly;
    }
};

//////////////////////////////////////////////////////////////////////////////////////////////////////////////////////////////////////////////////////////////////
