//////////////////////////////////////////////////////////////////////////////////////////////////////////////////////////////////////////////////////////////////
//Defining Pinouts////////////////////////////////////////////////////////////////////////////////////////////////////////////////////////////////////////////////
//////////////////////////////////////////////////////////////////////////////////////////////////////////////////////////////////////////////////////////////////

#define PIN_SENSOR A1         //Rename Pin A1 to PIN_SENSOR

//////////////////////////////////////////////////////////////////////////////////////////////////////////////////////////////////////////////////////////////////
//Defining Array Variables////////////////////////////////////////////////////////////////////////////////////////////////////////////////////////////////////////
//////////////////////////////////////////////////////////////////////////////////////////////////////////////////////////////////////////////////////////////////

const int Elements=20;
int Readings[Elements];
   
//////////////////////////////////////////////////////////////////////////////////////////////////////////////////////////////////////////////////////////////////
//Define Class///////////////////////////////////////////////////////////////////////////////////////////////////////////////////////////////////////////
//Defining Private Varibles///////////////////////////////////////////////////////////////////////////////////////////////////////////////////////////////////////
//////////////////////////////////////////////////////////////////////////////////////////////////////////////////////////////////////////////////////////////////

class ReadSensor{
  private:                                                                        
    unsigned long NextTimeChange = 0;
    unsigned long OnTime;
    unsigned long CurrentTime;
    byte Pin;                                 
    float SensorReading;
    int SensorAverage = 0;
    double Total = 0;   
    int Index = 0;
    float Voltage;
    bool Startup;
    bool getReading=true; 
    
//////////////////////////////////////////////////////////////////////////////////////////////////////////////////////////////////////////////////////////////////
//Pass data into private varibles/////////////////////////////////////////////////////////////////////////////////////////////////////////////////////////////////         
//////////////////////////////////////////////////////////////////////////////////////////////////////////////////////////////////////////////////////////////////    

  public:                                                                      
     ReadSensor(byte Pin, unsigned long OnTime) {
        this->Pin = Pin;                                              //Pass value for Pin to Private Class
        this->OnTime = OnTime;                                        //Pass value for OnTime to Private Class
        
        pinMode(Pin, INPUT);                                          //Declare Pin as an Input
    }
//////////////////////////////////////////////////////////////////////////////////////////////////////////////////////////////////////////////////////////////////
//Smooth Analog Read Values///////////////////////////////////////////////////////////////////////////////////////////////////////////////////////////////////////             
//////////////////////////////////////////////////////////////////////////////////////////////////////////////////////////////////////////////////////////////////

    void SmoothInput() {
      CheckTime();
      if (getReading){
        Total = Total - Readings[Index];                //Subtract Reading in Index position from Total before adding new reading
        Readings[Index] = analogRead(PIN_SENSOR);             //Get Value From Sensor
        Total = Total + Readings[Index];                //Add new reading to total
        Index = Index + 1;                              //Iterate to next position
        SensorAverage = Total/Elements;                 //Average the sum of the array                                 
        getReading=false;
        if (Startup) {                                  //If Bool Startup is true divide total by the index number to get average
          SensorAverage = Total/Index;
          if (Index==Elements){                         //When all elements have been populated change bool startup to false
            Startup=false;                              //This will allow for smoother initial startup
          }
        }
        else{
          SensorAverage = Total/Elements;               //Average the sum of the array                                 
        }
        if (Index >= Elements) {                        //If at last index position loop back to begaining
          Index = 0;
        }
        CalcVoltage();
      }
    }

//////////////////////////////////////////////////////////////////////////////////////////////////////////////////////////////////////////////////////////////////   
//Initialize Values In Array//////////////////////////////////////////////////////////////////////////////////////////////////////////////////////////////////////
//////////////////////////////////////////////////////////////////////////////////////////////////////////////////////////////////////////////////////////////////

    void Initialize(){
      for (int thisReading = 0; thisReading < Elements; thisReading++) {        //Iterates through Array setting values to 0
        Readings[thisReading] = 0;
      } 
      Startup = true;
    }
    
//////////////////////////////////////////////////////////////////////////////////////////////////////////////////////////////////////////////////////////////////
//Time Control for Smoothing and Sending Data/////////////////////////////////////////////////////////////////////////////////////////////////////////////////////
//////////////////////////////////////////////////////////////////////////////////////////////////////////////////////////////////////////////////////////////////

    void CheckTime(){           
      CurrentTime = millis();                               //Checks time and stores as CurrentTime                           
      if(CurrentTime >= NextTimeChange){                    //If CurrentTime is less than NextTimeChange
        getReading = true;                                    //Set CalDistbool = True
        NextTimeChange = NextTimeChange + OnTime;           //Increase NextTimeChange by OnTime 
      }
      else{
        getReading = false;                                   //Else set CalDistbool = False      
      }  
    }

//////////////////////////////////////////////////////////////////////////////////////////////////////////////////////////////////////////////////////////////////
//Calculate Voltage/////////////////////////////////////////////////////////////////////////////////////////////////////////////////////
//////////////////////////////////////////////////////////////////////////////////////////////////////////////////////////////////////////////////////////////////
    
    void CalcVoltage() {                                                                                           
        Voltage = SensorAverage * (5.00 / 1023.00);            //Calculate Voltage 
        Print(); 
      }                                                                                      
    
//////////////////////////////////////////////////////////////////////////////////////////////////////////////////////////////////////////////////////////////////
//Prints Distance Data////////////////////////////////////////////////////////////////////////////////////////////////////////////////////////////////////////////
//////////////////////////////////////////////////////////////////////////////////////////////////////////////////////////////////////////////////////////////////

    void Print() {                                                               
       Serial.print(Voltage);                                //Print to Terminal Distance Value                                               
       Serial.println();
    }
    
//////////////////////////////////////////////////////////////////////////////////////////////////////////////////////////////////////////////////////////////////
//Get Sensor Value////////////////////////////////////////////////////////////////////////////////////////////////////////////////////////////////////////////////
//////////////////////////////////////////////////////////////////////////////////////////////////////////////////////////////////////////////////////////////////

    float getVoltage(){                          //Stores value for voltage                                                                                                   
      return Voltage;
    }
};
//////////////////////////////////////////////////////////////////////////////////////////////////////////////////////////////////////////////////////////////////
